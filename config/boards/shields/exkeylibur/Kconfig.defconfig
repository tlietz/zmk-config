## config/boards/shields/exkeylibur/Kconfig.defconfig
```kconfig
if SHIELD_EXKEYLIBUR_LEFT

config ZMK_KEYBOARD_NAME
    default "Exkeylibur"

config ZMK_SPLIT_BLE_ROLE_CENTRAL
    default y

endif

if SHIELD_EXKEYLIBUR_LEFT || SHIELD_EXKEYLIBUR_RIGHT

config ZMK_SPLIT
    default y

endif
```

## config/boards/shields/exkeylibur/Kconfig.shield
```kconfig
config SHIELD_EXKEYLIBUR_LEFT
    def_bool $(shields_list_contains,exkeylibur_left)

config SHIELD_EXKEYLIBUR_RIGHT
    def_bool $(shields_list_contains,exkeylibur_right)
```
